## boards/shields/kawvin_63/Kconfig.defconfig
```kconfig
# Copyright (c) 2023 The ZMK Contributors
# SPDX-License-Identifier: MIT

#if SHIELD_KAWVIN_63

config ZMK_KEYBOARD_NAME
    default "Kawvin_63"

#config ZMK_SPLIT_ROLE_CENTRAL
#    default y

#endif # SHIELD_KAWVIN_63

choice BT_CTLR_TX_PWR
    default BT_CTLR_TX_PWR_PLUS_8
endchoice

choice ZMK_DISPLAY_WORK_QUEUE
    default ZMK_DISPLAY_WORK_QUEUE_DEDICATED
endchoice

if ZMK_DISPLAY

config SSD1306
    default y

config I2C
    default y

if LVGL

config LV_Z_VDB_SIZE
    default 64

config LV_DPI_DEF
    default 148

config LV_Z_BITS_PER_PIXEL
    default 1

choice LV_COLOR_DEPTH
    default LV_COLOR_DEPTH_1
endchoice

endif # LVGL

endif # ZMK_DISPLAY
```

## boards/shields/kawvin_63/Kconfig.shield
```kconfig
# Copyright (c) 2023 The ZMK Contributors
# SPDX-License-Identifier: MIT

config SHIELD_KAWVIN_63
    def_bool $(shields_list_contains,kawvin_63)
```
